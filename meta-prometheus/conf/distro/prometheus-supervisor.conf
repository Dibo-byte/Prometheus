## meta-prometheus/conf/distro/prometheus-supervisor.conf
```bitbake
require conf/distro/poky.conf

DISTRO = "prometheus-supervisor"
DISTRO_NAME = "Prometheus Supervisor"
DISTRO_VERSION = "1.0.0"


DISTRO_FEATURES:append = " systemd"
VIRTUAL-RUNTIME_init_manager = "systemd"
DISTRO_FEATURES_BACKFILL_CONSIDERED += "sysvinit"
VIRTUAL_RUNTIME_initscripts = "system-compat-units"

EXTRA_IMAGE_FEATURES ?= "debug-tweaks"
```
